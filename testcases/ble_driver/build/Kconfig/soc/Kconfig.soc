## testcases/ble_driver/build/Kconfig/soc/Kconfig.soc
```kconfig
# Load SoC Kconfig descriptions.
osource "/home/chenkaiqiu/zephyr/soc/xlnx/zynqmp/Kconfig.soc"
osource "/home/chenkaiqiu/zephyr/soc/xlnx/zynq7000/Kconfig.soc"
osource "/home/chenkaiqiu/zephyr/soc/xen/Kconfig.soc"
osource "/home/chenkaiqiu/zephyr/soc/ti/simplelink/Kconfig.soc"
osource "/home/chenkaiqiu/zephyr/soc/ti/lm3s6965/Kconfig.soc"
osource "/home/chenkaiqiu/zephyr/soc/ti/k3/Kconfig.soc"
osource "/home/chenkaiqiu/zephyr/soc/telink/tlsr/Kconfig.soc"
osource "/home/chenkaiqiu/zephyr/soc/starfive/jh71xx/Kconfig.soc"
osource "/home/chenkaiqiu/zephyr/soc/st/stm32/Kconfig.soc"
osource "/home/chenkaiqiu/zephyr/soc/snps/qemu_arc/Kconfig.soc"
osource "/home/chenkaiqiu/zephyr/soc/snps/nsim/arc_v/Kconfig.soc"
osource "/home/chenkaiqiu/zephyr/soc/snps/nsim/arc_classic/Kconfig.soc"
osource "/home/chenkaiqiu/zephyr/soc/snps/hsdk4xd/Kconfig.soc"
osource "/home/chenkaiqiu/zephyr/soc/snps/hsdk/Kconfig.soc"
osource "/home/chenkaiqiu/zephyr/soc/snps/emsk/Kconfig.soc"
osource "/home/chenkaiqiu/zephyr/soc/snps/emsdp/Kconfig.soc"
osource "/home/chenkaiqiu/zephyr/soc/snps/arc_iot/Kconfig.soc"
osource "/home/chenkaiqiu/zephyr/soc/silabs/Kconfig.soc"
osource "/home/chenkaiqiu/zephyr/soc/sifive/sifive_freedom/Kconfig.soc"
osource "/home/chenkaiqiu/zephyr/soc/rockchip/Kconfig.soc"
osource "/home/chenkaiqiu/zephyr/soc/renode/riscv_virtual/Kconfig.soc"
osource "/home/chenkaiqiu/zephyr/soc/renesas/smartbond/Kconfig.soc"
osource "/home/chenkaiqiu/zephyr/soc/renesas/rzt2m/Kconfig.soc"
osource "/home/chenkaiqiu/zephyr/soc/renesas/rcar/Kconfig.soc"
osource "/home/chenkaiqiu/zephyr/soc/renesas/ra/Kconfig.soc"
osource "/home/chenkaiqiu/zephyr/soc/raspberrypi/Kconfig.soc"
osource "/home/chenkaiqiu/zephyr/soc/quicklogic/eos_s3/Kconfig.soc"
osource "/home/chenkaiqiu/zephyr/soc/qemu/virt_riscv/Kconfig.soc"
osource "/home/chenkaiqiu/zephyr/soc/qemu/malta/Kconfig.soc"
osource "/home/chenkaiqiu/zephyr/soc/openisa/rv32m1/Kconfig.soc"
osource "/home/chenkaiqiu/zephyr/soc/nxp/s32/Kconfig.soc"
osource "/home/chenkaiqiu/zephyr/soc/nxp/rw/Kconfig.soc"
osource "/home/chenkaiqiu/zephyr/soc/nxp/mcx/Kconfig.soc"
osource "/home/chenkaiqiu/zephyr/soc/nxp/lpc/Kconfig.soc"
osource "/home/chenkaiqiu/zephyr/soc/nxp/layerscape/Kconfig.soc"
osource "/home/chenkaiqiu/zephyr/soc/nxp/kinetis/Kconfig.soc"
osource "/home/chenkaiqiu/zephyr/soc/nxp/imxrt/Kconfig.soc"
osource "/home/chenkaiqiu/zephyr/soc/nxp/imx/Kconfig.soc"
osource "/home/chenkaiqiu/zephyr/soc/nuvoton/numicro/Kconfig.soc"
osource "/home/chenkaiqiu/zephyr/soc/nuvoton/numaker/Kconfig.soc"
osource "/home/chenkaiqiu/zephyr/soc/nuvoton/npcx/Kconfig.soc"
osource "/home/chenkaiqiu/zephyr/soc/nordic/Kconfig.soc"
osource "/home/chenkaiqiu/zephyr/soc/neorv32/Kconfig.soc"
osource "/home/chenkaiqiu/zephyr/soc/native/inf_clock/Kconfig.soc"
osource "/home/chenkaiqiu/zephyr/soc/microchip/miv/Kconfig.soc"
osource "/home/chenkaiqiu/zephyr/soc/microchip/mec/Kconfig.soc"
osource "/home/chenkaiqiu/zephyr/soc/mediatek/mtk_adsp/Kconfig.soc"
osource "/home/chenkaiqiu/zephyr/soc/lowrisc/opentitan/Kconfig.soc"
osource "/home/chenkaiqiu/zephyr/soc/litex/litex_vexriscv/Kconfig.soc"
osource "/home/chenkaiqiu/zephyr/soc/ite/ec/Kconfig.soc"
osource "/home/chenkaiqiu/zephyr/soc/intel/raptor_lake/Kconfig.soc"
osource "/home/chenkaiqiu/zephyr/soc/intel/lakemont/Kconfig.soc"
osource "/home/chenkaiqiu/zephyr/soc/intel/intel_socfpga_std/Kconfig.soc"
osource "/home/chenkaiqiu/zephyr/soc/intel/intel_socfpga/Kconfig.soc"
osource "/home/chenkaiqiu/zephyr/soc/intel/intel_niosv/Kconfig.soc"
osource "/home/chenkaiqiu/zephyr/soc/intel/intel_ish/Kconfig.soc"
osource "/home/chenkaiqiu/zephyr/soc/intel/intel_adsp/Kconfig.soc"
osource "/home/chenkaiqiu/zephyr/soc/intel/elkhart_lake/Kconfig.soc"
osource "/home/chenkaiqiu/zephyr/soc/intel/atom/Kconfig.soc"
osource "/home/chenkaiqiu/zephyr/soc/intel/apollo_lake/Kconfig.soc"
osource "/home/chenkaiqiu/zephyr/soc/intel/alder_lake/Kconfig.soc"
osource "/home/chenkaiqiu/zephyr/soc/infineon/cat3/Kconfig.soc"
osource "/home/chenkaiqiu/zephyr/soc/infineon/cat1b/Kconfig.soc"
osource "/home/chenkaiqiu/zephyr/soc/infineon/cat1a/Kconfig.soc"
osource "/home/chenkaiqiu/zephyr/soc/gd/gd32/Kconfig.soc"
osource "/home/chenkaiqiu/zephyr/soc/gaisler/leon3/Kconfig.soc"
osource "/home/chenkaiqiu/zephyr/soc/gaisler/gr716a/Kconfig.soc"
osource "/home/chenkaiqiu/zephyr/soc/espressif/Kconfig.soc"
osource "/home/chenkaiqiu/zephyr/soc/ene/kb1200/Kconfig.soc"
osource "/home/chenkaiqiu/zephyr/soc/efinix/sapphire/Kconfig.soc"
osource "/home/chenkaiqiu/zephyr/soc/cdns/xtensa_sample_controller/Kconfig.soc"
osource "/home/chenkaiqiu/zephyr/soc/cdns/dc233c/Kconfig.soc"
osource "/home/chenkaiqiu/zephyr/soc/brcm/bcmvk/Kconfig.soc"
osource "/home/chenkaiqiu/zephyr/soc/brcm/bcm2712/Kconfig.soc"
osource "/home/chenkaiqiu/zephyr/soc/brcm/bcm2711/Kconfig.soc"
osource "/home/chenkaiqiu/zephyr/soc/atmel/sam0/Kconfig.soc"
osource "/home/chenkaiqiu/zephyr/soc/atmel/sam/Kconfig.soc"
osource "/home/chenkaiqiu/zephyr/soc/aspeed/Kconfig.soc"
osource "/home/chenkaiqiu/zephyr/soc/arm/Kconfig.soc"
osource "/home/chenkaiqiu/zephyr/soc/arm/beetle/Kconfig.soc"
osource "/home/chenkaiqiu/zephyr/soc/andestech/Kconfig.soc"
osource "/home/chenkaiqiu/zephyr/soc/ambiq/Kconfig.soc"
osource "/home/chenkaiqiu/zephyr/soc/altr/zephyr_nios2f/Kconfig.soc"
osource "/home/chenkaiqiu/zephyr/soc/altr/qemu_nios2/Kconfig.soc"
osource "/home/chenkaiqiu/zephyr/soc/adi/max32/Kconfig.soc"
```

## testcases/eth_driver/build/Kconfig/arch/Kconfig
```kconfig
# Load arch Kconfig descriptions.
osource "/home/chenkaiqiu/zephyr/arch/x86/Kconfig"
osource "/home/chenkaiqiu/zephyr/arch/xtensa/Kconfig"
osource "/home/chenkaiqiu/zephyr/arch/sparc/Kconfig"
osource "/home/chenkaiqiu/zephyr/arch/riscv/Kconfig"
osource "/home/chenkaiqiu/zephyr/arch/posix/Kconfig"
osource "/home/chenkaiqiu/zephyr/arch/nios2/Kconfig"
osource "/home/chenkaiqiu/zephyr/arch/mips/Kconfig"
osource "/home/chenkaiqiu/zephyr/arch/arm64/Kconfig"
osource "/home/chenkaiqiu/zephyr/arch/arm/Kconfig"
osource "/home/chenkaiqiu/zephyr/arch/arc/Kconfig"
```

## testcases/eth_driver/build/Kconfig/soc/Kconfig
```kconfig
# Load Zephyr SoC Kconfig descriptions.
osource "/home/chenkaiqiu/zephyr/soc/xlnx/zynqmp/Kconfig"
osource "/home/chenkaiqiu/zephyr/soc/xlnx/zynq7000/Kconfig"
osource "/home/chenkaiqiu/zephyr/soc/xen/Kconfig"
osource "/home/chenkaiqiu/zephyr/soc/ti/simplelink/Kconfig"
osource "/home/chenkaiqiu/zephyr/soc/ti/lm3s6965/Kconfig"
osource "/home/chenkaiqiu/zephyr/soc/ti/k3/Kconfig"
osource "/home/chenkaiqiu/zephyr/soc/telink/tlsr/Kconfig"
osource "/home/chenkaiqiu/zephyr/soc/starfive/jh71xx/Kconfig"
osource "/home/chenkaiqiu/zephyr/soc/st/stm32/Kconfig"
osource "/home/chenkaiqiu/zephyr/soc/snps/qemu_arc/Kconfig"
osource "/home/chenkaiqiu/zephyr/soc/snps/nsim/arc_v/Kconfig"
osource "/home/chenkaiqiu/zephyr/soc/snps/nsim/arc_classic/Kconfig"
osource "/home/chenkaiqiu/zephyr/soc/snps/hsdk4xd/Kconfig"
osource "/home/chenkaiqiu/zephyr/soc/snps/hsdk/Kconfig"
osource "/home/chenkaiqiu/zephyr/soc/snps/emsk/Kconfig"
osource "/home/chenkaiqiu/zephyr/soc/snps/emsdp/Kconfig"
osource "/home/chenkaiqiu/zephyr/soc/snps/arc_iot/Kconfig"
osource "/home/chenkaiqiu/zephyr/soc/silabs/Kconfig"
osource "/home/chenkaiqiu/zephyr/soc/sifive/sifive_freedom/Kconfig"
osource "/home/chenkaiqiu/zephyr/soc/rockchip/Kconfig"
osource "/home/chenkaiqiu/zephyr/soc/renode/riscv_virtual/Kconfig"
osource "/home/chenkaiqiu/zephyr/soc/renesas/smartbond/Kconfig"
osource "/home/chenkaiqiu/zephyr/soc/renesas/rzt2m/Kconfig"
osource "/home/chenkaiqiu/zephyr/soc/renesas/rcar/Kconfig"
osource "/home/chenkaiqiu/zephyr/soc/renesas/ra/Kconfig"
osource "/home/chenkaiqiu/zephyr/soc/raspberrypi/Kconfig"
osource "/home/chenkaiqiu/zephyr/soc/quicklogic/eos_s3/Kconfig"
osource "/home/chenkaiqiu/zephyr/soc/qemu/virt_riscv/Kconfig"
osource "/home/chenkaiqiu/zephyr/soc/qemu/malta/Kconfig"
osource "/home/chenkaiqiu/zephyr/soc/openisa/rv32m1/Kconfig"
osource "/home/chenkaiqiu/zephyr/soc/nxp/s32/Kconfig"
osource "/home/chenkaiqiu/zephyr/soc/nxp/rw/Kconfig"
osource "/home/chenkaiqiu/zephyr/soc/nxp/mcx/Kconfig"
osource "/home/chenkaiqiu/zephyr/soc/nxp/lpc/Kconfig"
osource "/home/chenkaiqiu/zephyr/soc/nxp/layerscape/Kconfig"
osource "/home/chenkaiqiu/zephyr/soc/nxp/kinetis/Kconfig"
osource "/home/chenkaiqiu/zephyr/soc/nxp/imxrt/Kconfig"
osource "/home/chenkaiqiu/zephyr/soc/nxp/imx/Kconfig"
osource "/home/chenkaiqiu/zephyr/soc/nuvoton/numicro/Kconfig"
osource "/home/chenkaiqiu/zephyr/soc/nuvoton/numaker/Kconfig"
osource "/home/chenkaiqiu/zephyr/soc/nuvoton/npcx/Kconfig"
osource "/home/chenkaiqiu/zephyr/soc/nordic/Kconfig"
osource "/home/chenkaiqiu/zephyr/soc/neorv32/Kconfig"
osource "/home/chenkaiqiu/zephyr/soc/native/inf_clock/Kconfig"
osource "/home/chenkaiqiu/zephyr/soc/microchip/miv/Kconfig"
osource "/home/chenkaiqiu/zephyr/soc/microchip/mec/Kconfig"
osource "/home/chenkaiqiu/zephyr/soc/mediatek/mtk_adsp/Kconfig"
osource "/home/chenkaiqiu/zephyr/soc/lowrisc/opentitan/Kconfig"
osource "/home/chenkaiqiu/zephyr/soc/litex/litex_vexriscv/Kconfig"
osource "/home/chenkaiqiu/zephyr/soc/ite/ec/Kconfig"
osource "/home/chenkaiqiu/zephyr/soc/intel/raptor_lake/Kconfig"
osource "/home/chenkaiqiu/zephyr/soc/intel/lakemont/Kconfig"
osource "/home/chenkaiqiu/zephyr/soc/intel/intel_socfpga_std/Kconfig"
osource "/home/chenkaiqiu/zephyr/soc/intel/intel_socfpga/Kconfig"
osource "/home/chenkaiqiu/zephyr/soc/intel/intel_niosv/Kconfig"
osource "/home/chenkaiqiu/zephyr/soc/intel/intel_ish/Kconfig"
osource "/home/chenkaiqiu/zephyr/soc/intel/intel_adsp/Kconfig"
osource "/home/chenkaiqiu/zephyr/soc/intel/elkhart_lake/Kconfig"
osource "/home/chenkaiqiu/zephyr/soc/intel/atom/Kconfig"
osource "/home/chenkaiqiu/zephyr/soc/intel/apollo_lake/Kconfig"
osource "/home/chenkaiqiu/zephyr/soc/intel/alder_lake/Kconfig"
osource "/home/chenkaiqiu/zephyr/soc/infineon/cat3/Kconfig"
osource "/home/chenkaiqiu/zephyr/soc/infineon/cat1b/Kconfig"
osource "/home/chenkaiqiu/zephyr/soc/infineon/cat1a/Kconfig"
osource "/home/chenkaiqiu/zephyr/soc/gd/gd32/Kconfig"
osource "/home/chenkaiqiu/zephyr/soc/gaisler/leon3/Kconfig"
osource "/home/chenkaiqiu/zephyr/soc/gaisler/gr716a/Kconfig"
osource "/home/chenkaiqiu/zephyr/soc/espressif/Kconfig"
osource "/home/chenkaiqiu/zephyr/soc/ene/kb1200/Kconfig"
osource "/home/chenkaiqiu/zephyr/soc/efinix/sapphire/Kconfig"
osource "/home/chenkaiqiu/zephyr/soc/cdns/xtensa_sample_controller/Kconfig"
osource "/home/chenkaiqiu/zephyr/soc/cdns/dc233c/Kconfig"
osource "/home/chenkaiqiu/zephyr/soc/brcm/bcmvk/Kconfig"
osource "/home/chenkaiqiu/zephyr/soc/brcm/bcm2712/Kconfig"
osource "/home/chenkaiqiu/zephyr/soc/brcm/bcm2711/Kconfig"
osource "/home/chenkaiqiu/zephyr/soc/atmel/sam0/Kconfig"
osource "/home/chenkaiqiu/zephyr/soc/atmel/sam/Kconfig"
osource "/home/chenkaiqiu/zephyr/soc/aspeed/Kconfig"
osource "/home/chenkaiqiu/zephyr/soc/arm/Kconfig"
osource "/home/chenkaiqiu/zephyr/soc/arm/beetle/Kconfig"
osource "/home/chenkaiqiu/zephyr/soc/andestech/Kconfig"
osource "/home/chenkaiqiu/zephyr/soc/ambiq/Kconfig"
osource "/home/chenkaiqiu/zephyr/soc/altr/zephyr_nios2f/Kconfig"
osource "/home/chenkaiqiu/zephyr/soc/altr/qemu_nios2/Kconfig"
osource "/home/chenkaiqiu/zephyr/soc/adi/max32/Kconfig"
```
